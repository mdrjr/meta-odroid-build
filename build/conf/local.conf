## build/conf/local.conf
```bitbake
MACHINE ?= "@BOARD@"

DISTRO ?= "poky"

USER_CLASSES ?= "buildstats"
PATCHRESOLVE = "noop"

BB_DISKMON_DIRS ??= "\
    STOPTASKS,${TMPDIR},1G,100K \
    STOPTASKS,${DL_DIR},1G,100K \
    STOPTASKS,${SSTATE_DIR},1G,100K \
    STOPTASKS,/tmp,100M,100K \
    HALT,${TMPDIR},100M,1K \
    HALT,${DL_DIR},100M,1K \
    HALT,${SSTATE_DIR},100M,1K \
    HALT,/tmp,10M,1K"

CONF_VERSION = "2"

LICENSE_FLAGS_ACCEPTED = "commercial" 

CLANGSDK = "1"

INSANE_SKIP:append = " host-user-contaminated"

IMAGE_FEATURES += "allow-empty-password allow-root-login empty-root-password post-install-logging package-management"
PACKAGE_CLASS ?= "package_deb"

DISTRO_FEATURES:remove = "ptest vulkan"

DISTRO_FEATURES:append = " pam"

ERROR_QA:remove = "patch-status"
WARN_QA:remove = "patch-fuzz"

CORE_IMAGE_EXTRA_INSTALL += " odroid-image"

INHERIT:remove = "create-spdx"
```
